/*
 * lcd.c
 *
 *  Created on: Jul 10, 2022
 *      Author: 27731
 */

#include "lcd.h"
#include "CH57x_common.h"

__attribute__((aligned(4))) uint8_t spiBuff[] = {1, 2, 3, 4, 5, 6, 7, 8, 9, 0, 1, 2, 3, 4, 5, 6};
__attribute__((aligned(4))) uint8_t spiBuffrev[16];

#if 1
//12*12 ASCII字符集点阵
const unsigned char asc2_1206[95][12]=
{
    {0x00,0x00,0x00,0x00,0x00,0x00,0x00,0x00,0x00,0x00,0x00,0x00},/*" ",0*/
    {0x00,0x00,0x00,0x00,0x3F,0x40,0x00,0x00,0x00,0x00,0x00,0x00},/*"!",1*/
    {0x00,0x00,0x30,0x00,0x40,0x00,0x30,0x00,0x40,0x00,0x00,0x00},/*""",2*/
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    {0x40,0x00,0x80,0x00,0x40,0x00,0x20,0x00,0x20,0x00,0x40,0x00},/*"~",94*/
};
//16*16 ASCII字符集点阵
const unsigned char asc2_1608[95][16]=
{
    {0x00,0x00,0x00,0x00,0x00,0x00,0x00,0x00,0x00,0x00,0x00,0x00,0x00,0x00,0x00,0x00},/*" ",0*/
    {0x00,0x00,0x00,0x00,0x00,0x00,0x1F,0xCC,0x00,0x0C,0x00,0x00,0x00,0x00,0x00,0x00},/*"!",1*/
    {0x00,0x00,0x08,0x00,0x30,0x00,0x60,0x00,0x08,0x00,0x30,0x00,0x60,0x00,0x00,0x00},/*""",2*/
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    {0x00,0x00,0x60,0x00,0x80,0x00,0x80,0x00,0x40,0x00,0x40,0x00,0x20,0x00,0x20,0x00},/*"~",94*/
};
//24*24 ASICII字符集点阵
const unsigned char asc2_2412[95][36]=
{
    {0x00,0x00,0x00,0x00,0x00,0x00,0x00,0x00,0x00,0x00,0x00,0x00,0x00,0x00,0x00,0x00,0x00,0x00,0x00,0x00,0x00,0x00,0x00,0x00,0x00,0x00,0x00,0x00,0x00,0x00,0x00,0x00,0x00,0x00,0x00,0x00},/*" ",0*/
    {0x00,0x00,0x00,0x00,0x00,0x00,0x00,0x00,0x00,0x00,0x00,0x00,0x00,0x00,0x00,0x0F,0x80,0x38,0x0F,0xFE,0x38,0x0F,0x80,0x38,0x00,0x00,0x00,0x00,0x00,0x00,0x00,0x00,0x00,0x00,0x00,0x00},/*"!",1*/
    {0x00,0x00,0x00,0x00,0x00,0x00,0x01,0x00,0x00,0x06,0x00,0x00,0x0C,0x00,0x00,0x38,0x00,0x00,0x31,0x00,0x00,0x06,0x00,0x00,0x0C,0x00,0x00,0x38,0x00,0x00,0x30,0x00,0x00,0x00,0x00,0x00},/*""",2*/
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    {0x00,0x00,0x00,0x18,0x00,0x00,0x60,0x00,0x00,0x40,0x00,0x00,0x40,0x00,0x00,0x20,0x00,0x00,0x10,0x00,0x00,0x08,0x00,0x00,0x04,0x00,0x00,0x04,0x00,0x00,0x0C,0x00,0x00,0x10,0x00,0x00},/*"~",94*/
};

const char* font1616_table =
{
    "语言选择旋转显示固件升级恢复出厂版本信息系统启动中请稍等片刻待机时间关开应按键英文简繁体分钟秒软硬使能打闭保留睡眠倒计退确定取消語選擇轉顯級復廠統啟動請機時間關開應鍵簡體鐘軟閉計確"
};

const unsigned char font_1616[][32]= {
    0x02,0x00,0x42,0x00,0x33,0xFE,0x00,0x04,0x00,0x08,0x41,0x00,0x49,0x3F,0x49,0x22,
    0x4F,0x22,0x79,0x22,0x49,0x22,0x49,0x22,0x4F,0x3F,0x41,0x00,0x01,0x00,0x00,0x00,/*"语",0*/
    0x20,0x00,0x20,0x00,0x24,0x9F,0x24,0x92,0x24,0x92,0x24,0x92,0xA4,0x92,0x64,0x92,
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    0x3C,0x92,0xE4,0x92,0x34,0x92,0x2F,0xFE,0x24,0x92,0x24,0x92,0x34,0x92,0x00,0x00,/*"確",21*/
};

#endif

void LCD_GPIO_Init(void)
{
    if(0)
    {
        //背光
        GPIOB_ResetBits(GPIO_Pin_4);
        GPIOB_ModeCfg(GPIO_Pin_4, GPIO_ModeOut_PP_5mA);
    }
    GPIOA_SetBits(GPIO_Pin_5);//DC
    GPIOA_SetBits(GPIO_Pin_15);//RST
    GPIOA_SetBits(GPIO_Pin_12);//CS

    GPIOA_ModeCfg(GPIO_Pin_5 | GPIO_Pin_12 | GPIO_Pin_15, GPIO_ModeOut_PP_5mA);

    GPIOA_ModeCfg(GPIO_Pin_13 | GPIO_Pin_14, GPIO_ModeOut_PP_5mA);
#if 1
    R8_SPI0_CLOCK_DIV = 4; // 主频时钟4分频
    R8_SPI0_CTRL_MOD = RB_SPI_ALL_CLEAR;
    R8_SPI0_CTRL_MOD = RB_SPI_MOSI_OE | RB_SPI_SCK_OE;
    R8_SPI0_CTRL_CFG |= RB_SPI_AUTO_IF;     // 访问BUFFER/FIFO自动清除IF_BYTE_END标志
    R8_SPI0_CTRL_CFG &= ~RB_SPI_DMA_ENABLE; // 不启动DMA方式

    SPI0_DataMode(3);
#endif
}

/******************************************************************************
      函数说明：LCD串行数据写入函数
      入口数据：dat  要写入的串行数据
      返回值：  无
******************************************************************************/
void LCD_Writ_Bus(uint8_t dat)
{
    uint8_t i;
    LCD_CS_Clr();
#if 0
    for(i=0; i<8; i++)
    {
        LCD_SCLK_Clr();
        if(dat&0x80)
        {
            LCD_MOSI_Set();
        }
        else
        {
            LCD_MOSI_Clr();
        }
        LCD_SCLK_Set();
        dat<<=1;
    }
#else
    SPI0_MasterSendByte(dat);
#endif
    LCD_CS_Set();
}


/******************************************************************************
      函数说明：LCD写入数据
      入口数据：dat 写入的数据
      返回值：  无
******************************************************************************/
void LCD_WR_DATA8(uint8_t dat)
{
    LCD_Writ_Bus(dat);
}


/******************************************************************************
      函数说明：LCD写入数据
      入口数据：dat 写入的数据
      返回值：  无
******************************************************************************/
void LCD_WR_DATA(uint16_t dat)
{
    LCD_Writ_Bus(dat>>8);
    LCD_Writ_Bus(dat);
}


/******************************************************************************
      函数说明：LCD写入命令
      入口数据：dat 写入的命令
      返回值：  无
******************************************************************************/
void LCD_WR_REG(uint8_t dat)
{
    LCD_DC_Clr();//写命令
    LCD_Writ_Bus(dat);
    LCD_DC_Set();//写数据
}


/******************************************************************************
      函数说明：设置起始和结束地址
      入口数据：x1,x2 设置列的起始和结束地址
                y1,y2 设置行的起始和结束地址
      返回值：  无
******************************************************************************/
void LCD_Address_Set(uint16_t x1,uint16_t y1,uint16_t x2,uint16_t y2)
{
    if(USE_HORIZONTAL==0)
    {
        LCD_WR_REG(0x2a);//列地址设置
        LCD_WR_DATA(x1+26);
        LCD_WR_DATA(x2+26);
        LCD_WR_REG(0x2b);//行地址设置
        LCD_WR_DATA(y1+1);
        LCD_WR_DATA(y2+1);
        LCD_WR_REG(0x2c);//储存器写
    }
    else if(USE_HORIZONTAL==1)
    {
        LCD_WR_REG(0x2a);//列地址设置
        LCD_WR_DATA(x1+26);
        LCD_WR_DATA(x2+26);
        LCD_WR_REG(0x2b);//行地址设置
        LCD_WR_DATA(y1+1);
        LCD_WR_DATA(y2+1);
        LCD_WR_REG(0x2c);//储存器写
    }
    else if(USE_HORIZONTAL==2)
    {
        LCD_WR_REG(0x2a);//列地址设置
        LCD_WR_DATA(x1+1);
        LCD_WR_DATA(x2+1);
        LCD_WR_REG(0x2b);//行地址设置
        LCD_WR_DATA(y1+26);
        LCD_WR_DATA(y2+26);
        LCD_WR_REG(0x2c);//储存器写
    }
    else
    {
        LCD_WR_REG(0x2a);//列地址设置
        LCD_WR_DATA(x1+1);
        LCD_WR_DATA(x2+1);
        LCD_WR_REG(0x2b);//行地址设置
        LCD_WR_DATA(y1+26);
        LCD_WR_DATA(y2+26);
        LCD_WR_REG(0x2c);//储存器写
    }
}

void LCD_Init(void)
{
    LCD_GPIO_Init();//初始化GPIO

//    LCD_WR_REG(0x01);
//    DelayMs(120);
    LCD_RES_Clr();//复位
    DelayMs(5);
    LCD_RES_Set();
    DelayMs(120);
//    LCD_BLK_Set();//打开背光
    //************* Start Initial Sequence **********//
    LCD_WR_REG(0x11);     //Sleep out
    DelayMs(120);                //Delay 120ms
    LCD_WR_REG(0xB1);     //Normal mode
    LCD_WR_DATA8(0x05);
    LCD_WR_DATA8(0x3C);
    LCD_WR_DATA8(0x3C);
    LCD_WR_REG(0xB2);     //Idle mode
    LCD_WR_DATA8(0x05);
    LCD_WR_DATA8(0x3C);
    LCD_WR_DATA8(0x3C);
    LCD_WR_REG(0xB3);     //Partial mode
    LCD_WR_DATA8(0x05);
    LCD_WR_DATA8(0x3C);
    LCD_WR_DATA8(0x3C);
    LCD_WR_DATA8(0x05);
    LCD_WR_DATA8(0x3C);
    LCD_WR_DATA8(0x3C);
    LCD_WR_REG(0xB4);     //Dot inversion
    LCD_WR_DATA8(0x03);
    LCD_WR_REG(0xC0);     //AVDD GVDD
    LCD_WR_DATA8(0xAB);
    LCD_WR_DATA8(0x0B);
    LCD_WR_DATA8(0x04);
    LCD_WR_REG(0xC1);     //VGH VGL
    LCD_WR_DATA8(0xC5);   //C0
    LCD_WR_REG(0xC2);     //Normal Mode
    LCD_WR_DATA8(0x0D);
    LCD_WR_DATA8(0x00);
    LCD_WR_REG(0xC3);     //Idle
    LCD_WR_DATA8(0x8D);
    LCD_WR_DATA8(0x6A);
    LCD_WR_REG(0xC4);     //Partial+Full
    LCD_WR_DATA8(0x8D);
    LCD_WR_DATA8(0xEE);
    LCD_WR_REG(0xC5);     //VCOM
    LCD_WR_DATA8(0x0F);
    LCD_WR_REG(0xE0);     //positive gamma
    LCD_WR_DATA8(0x07);
    LCD_WR_DATA8(0x0E);
    LCD_WR_DATA8(0x08);
    LCD_WR_DATA8(0x07);
    LCD_WR_DATA8(0x10);
    LCD_WR_DATA8(0x07);
    LCD_WR_DATA8(0x02);
    LCD_WR_DATA8(0x07);
    LCD_WR_DATA8(0x09);
    LCD_WR_DATA8(0x0F);
    LCD_WR_DATA8(0x25);
    LCD_WR_DATA8(0x36);
    LCD_WR_DATA8(0x00);
    LCD_WR_DATA8(0x08);
    LCD_WR_DATA8(0x04);
    LCD_WR_DATA8(0x10);
    LCD_WR_REG(0xE1);     //negative gamma
    LCD_WR_DATA8(0x0A);
    LCD_WR_DATA8(0x0D);
    LCD_WR_DATA8(0x08);
    LCD_WR_DATA8(0x07);
    LCD_WR_DATA8(0x0F);
    LCD_WR_DATA8(0x07);
    LCD_WR_DATA8(0x02);
    LCD_WR_DATA8(0x07);
    LCD_WR_DATA8(0x09);
    LCD_WR_DATA8(0x0F);
    LCD_WR_DATA8(0x25);
    LCD_WR_DATA8(0x35);
    LCD_WR_DATA8(0x00);
    LCD_WR_DATA8(0x09);
    LCD_WR_DATA8(0x04);
    LCD_WR_DATA8(0x10);

    LCD_WR_REG(0xFC);
    LCD_WR_DATA8(0x80);

    LCD_WR_REG(0x3A);
    LCD_WR_DATA8(0x05);
    LCD_WR_REG(0x36);
    if(USE_HORIZONTAL==0)LCD_WR_DATA8(0x08);
    else if(USE_HORIZONTAL==1)LCD_WR_DATA8(0xC8);
    else if(USE_HORIZONTAL==2)LCD_WR_DATA8(0x78);
    else LCD_WR_DATA8(0xA8);
    LCD_WR_REG(0x21);     //Display inversion
    LCD_WR_REG(0x29);     //Display on
    LCD_WR_REG(0x2A);     //Set Column Address
    LCD_WR_DATA8(0x00);
    LCD_WR_DATA8(0x1A);  //26
    LCD_WR_DATA8(0x00);
    LCD_WR_DATA8(0x69);   //105
    LCD_WR_REG(0x2B);     //Set Page Address
    LCD_WR_DATA8(0x00);
    LCD_WR_DATA8(0x01);    //1
    LCD_WR_DATA8(0x00);
    LCD_WR_DATA8(0xA0);    //160
    LCD_WR_REG(0x2C);
}

/******************************************************************************
      函数说明：在指定区域填充颜色
      入口数据：xsta,ysta   起始坐标
                xend,yend   终止坐标
                                color       要填充的颜色
      返回值：  无
******************************************************************************/
void LCD_Fill(uint16_t xsta,uint16_t ysta,uint16_t xend,uint16_t yend,uint16_t color)
{
    uint16_t i,j;
    LCD_Address_Set(xsta,ysta,xend-1,yend-1);//设置显示范围
    for(i=ysta;i<yend;i++)
    {
        for(j=xsta;j<xend;j++)
        {
            LCD_WR_DATA(color);
        }
    }
}

/******************************************************************************
      函数说明：在指定位置画点
      入口数据：x,y 画点坐标
                color 点的颜色
      返回值：  无
******************************************************************************/
void LCD_DrawPoint(uint16_t x,uint16_t y,uint16_t color)
{
    LCD_Address_Set(x,y,x,y);//设置光标位置
    LCD_WR_DATA(color);
}

//画线
//x1,y1:起点坐标
//x2,y2:结束坐标
void LCD_DrawLine(int8_t x1,int8_t y1,int8_t x2,int8_t y2,uint16_t color)
{
    uint16_t t;
    int xerr=0,yerr=0,delta_x,delta_y,distance;
    int incx,incy,uRow,uCol;
    delta_x=x2-x1; //计算坐标增量
    delta_y=y2-y1;
    uRow=x1;//画线起点坐标
    uCol=y1;
    if(delta_x>0)incx=1; //设置单步方向
    else if (delta_x==0)incx=0;//垂直线
    else {
        incx=-1;
        delta_x=-delta_x;
    }
    if(delta_y>0)incy=1;
    else if (delta_y==0)incy=0;//水平线
    else {
        incy=-1;
        delta_y=-delta_x;
    }
    if(delta_x>delta_y)distance=delta_x; //选取基本增量坐标轴
    else distance=delta_y;
    for(t=0; t<distance+1; t++)
    {
        LCD_DrawPoint(uRow,uCol,color);//画点
        xerr+=delta_x;
        yerr+=delta_y;
        if(xerr>distance)
        {
            xerr-=distance;
            uRow+=incx;
        }
        if(yerr>distance)
        {
            yerr-=distance;
            uCol+=incy;
        }
    }
}
//x,y:圆心坐标
//r:圆的半径
void LCD_DrawCircle(int8_t x,int8_t y,uint8_t r,uint16_t color)
{
    int a, b,num;
    a = 0;
    b = r;
    while(2 * b * b >= r * r)
    {
        LCD_DrawPoint(x + a, y - b,color);
        LCD_DrawPoint(x - a, y - b,color);
        LCD_DrawPoint(x - a, y + b,color);
        LCD_DrawPoint(x + a, y + b,color);

        LCD_DrawPoint(x + b, y + a,color);
        LCD_DrawPoint(x + b, y - a,color);
        LCD_DrawPoint(x - b, y - a,color);
        LCD_DrawPoint(x - b, y + a,color);

        a++;
        num = (a * a + b * b) - r*r;//计算画的点离圆心的距离
        if(num > 0)
        {
            b--;
            a--;
        }
    }
}

//在指定位置显示一个字符,包括部分字符
//x:0~127
//y:0~63
//mode:0,反白显示;1,正常显示
//size:选择字体 12/16/24
void LCD_ShowChar(uint8_t x,uint8_t y,char chr,uint8_t size,uint16_t color)
{
    uint8_t temp,t,t1;
    uint8_t y0=y;
    uint8_t csize=(size/8+((size%8)?1:0))*(size/2); //得到字体一个字符对应点阵集所占的字节数
    chr=chr-' ';//得到偏移后的值
    for(t=0; t<csize; t++)
    {
        if(size==12)temp=asc2_1206[chr][t];         //调用1206字体
        else if(size==16)temp=asc2_1608[chr][t];    //调用1608字体
        else if(size==24)temp=asc2_2412[chr][t];    //调用2412字体
        else return;    //没有的字库
        for(t1=0; t1<8; t1++)
        {
            if(temp&0x80)LCD_DrawPoint(x,y,color);
            //else LCD_DrawPoint(x,y,!color);
            temp<<=1;
            y++;
            if((y-y0)==size)
            {
                y=y0;
                x++;
                break;
            }
        }
    }
}
//m^n函数
uint32_t mypow(uint8_t m,uint8_t n)
{
    uint32_t result=1;
    while(n--)result*=m;
    return result;
}
//显示2个数字
//x,y :起点坐标
//len :数字的位数
//size:字体大小
//mode:模式   0,填充模式;1,叠加模式
//num:数值(0~4294967295);
void LCD_ShowNum(uint8_t x,uint8_t y,uint32_t num,uint8_t len,uint8_t size,uint16_t color)
{
    uint8_t t,temp;
    uint8_t enshow=0;
    for(t=0; t<len; t++)
    {
        temp=(num/mypow(10,len-t-1))%10;
        if(enshow==0&&t<(len-1))
        {
            if(temp==0)
            {
                LCD_ShowChar(x+(size/2)*t,y,' ',size,color);
                continue;
            } else enshow=1;

        }
        LCD_ShowChar(x+(size/2)*t,y,temp+'0',size,color);
    }
}
//显示字符串
//x,y:起点坐标
//size:字体大小
//*p:字符串起始地址
void LCD_ShowString(uint8_t x,uint8_t y,char *p,uint8_t size,uint16_t color)
{
    while((*p<='~')&&(*p>=' '))//判断是不是非法字符!
    {
        if(x>(LCD_W-(size/2))) {
            x=0;
            y+=size;
        }
        if(y>(LCD_H-size)) {
            y=x=0;
        }
        LCD_ShowChar(x,y,*p,size,color);
        x+=size/2;
        p++;
    }

}

//显示一个指定大小的汉字
//x,y :汉字的坐标
//font:汉字GBK码
//f_w:字宽
//f_h:字高
//mode:0,正常显示,1,叠加显示
void show_font(uint16_t x,uint16_t y,const char *font,uint8_t f_w,uint8_t f_h,uint16_t color)
{
    const char* font_table;
    uint16_t fontSeq;
    uint8_t temp,t,t1;
    uint16_t y0=y;
    uint8_t csize=(f_h/8+((f_h%8)?1:0))*f_w;//得到自由分辨字符所占的字节数

    if(f_w==16 && f_h==16)
        font_table = font1616_table;
    else return;/*没有的字库*/
    for(fontSeq=0; fontSeq<strlen(font_table)/2; fontSeq++)/*计算font_table对应字库的数组下标*/
    {
        if(font_table[2*fontSeq]==font[0] && font_table[2*fontSeq+1]==font[1])
            break;
    }
    if(fontSeq >= strlen(font_table)/2) return;/*font_table中没有font该字*/

    for(t=0; t<csize; t++)
    {
        if(f_w==16 && f_h==16)
            temp = font_1616[fontSeq][t];/*调用font_1616字库*/
        for(t1=0; t1<8; t1++)
        {
            if(temp&0x80)LCD_DrawPoint(x,y,color);
            //else LCD_DrawPoint(x,y,!color);
            temp<<=1;
            y++;
            if((y-y0)==f_h)
            {
                y=y0;
                x++;
                break;
            }
        }
    }
}

//在指定位置开始显示一个字符串
//支持自动换行
//(x,y):起始坐标
//width,height:区域
//str  :字符串
//f_w:字宽
//f_h:字高
//mode:0,非叠加方式;1,叠加方式
void show_str(uint16_t x,uint16_t y,char *str,uint8_t f_h,uint16_t color)
{
    uint16_t x0=x;
    uint16_t y0=y;
    uint8_t bHz=0;     //字符或者中文
    while(*str!=0)//数据未结束
    {
        if(!bHz)
        {
            if((uint8_t)*str>0x80)bHz=1;//中文
            else               //字符
            {
                if(x>(x0+LCD_W-f_h/2))//换行
                {
                    y+=f_h;
                    x=x0;
                }
                if(y>(y0+LCD_H-f_h))break;//越界返回
                if(*str==13)//换行符号
                {
                    y+=f_h;
                    x=x0;
                    str++;
                }
                else LCD_ShowChar(x,y,*str,f_h,color);//有效部分写入
                str++;
                x+=f_h/2; //字符,为全字的一半
            }
        }
        else//中文
        {
            bHz=0;//有汉字库
            if(x>(x0+LCD_W-f_h))//换行
            {
                y+=f_h+2;//2为行间距
                x=x0;
            }
            if(y>(y0+LCD_H-f_h))
                break;//越界返回
            show_font(x,y,str,f_h,f_h,color); //显示这个汉字,空心显示
            str+=2;
            x+=f_h;//下一个汉字偏移
        }
    }
}
//在指定宽度的中间显示字符串
//如果字符长度超过了len,则用Show_Str显示
//len:指定要显示的宽度
void show_str_mid(uint16_t x,uint16_t y,char *str,uint8_t f_h,uint16_t color,uint16_t len)
{
    uint16_t strlenth=0;
    strlenth=strlen((char*)str);
    strlenth*=f_h/2;
    if(strlenth>len)show_str(x,y,str,f_h,color);
    else
    {
        strlenth=(len-strlenth)/2;
        show_str(strlenth+x,y,str,f_h,color);
    }
}

//10*16==宽*高  电量.bmp*13
const unsigned char bmp_battery[13][20]=
{
    {0x3F,0xFF,0x20,0x01,0x20,0x01,0xE0,0x01,0x80,0x01,0x80,0x01,0xE0,0x01,0x20,0x01,0x20,0x01,0x3F,0xFF},/*0格电量.BMP*/
    {0x3F,0xFF,0x20,0x03,0x20,0x03,0xE0,0x03,0x80,0x03,0x80,0x03,0xE0,0x03,0x20,0x03,0x20,0x03,0x3F,0xFF},/*1格电量.BMP*/
    {0x3F,0xFF,0x20,0x07,0x20,0x07,0xE0,0x07,0x80,0x07,0x80,0x07,0xE0,0x07,0x20,0x07,0x20,0x07,0x3F,0xFF},/*2格电量.BMP*/
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    {0x3F,0xFF,0x3F,0xFF,0x3F,0xFF,0xFF,0xFF,0x9F,0xFF,0x9F,0xFF,0xFF,0xFF,0x3F,0xFF,0x3F,0xFF,0x3F,0xFF},/*12格电量.BMP*/
};

const uint8_t bmp_16x16_sel_ico[] =
{
    0x00, 0x00, 0x00, 0xE0, 0x01, 0x20, 0x02, 0x20, 0x1C, 0x40, 0xE0, 0x7E, 0x80, 0x01, 0x80, 0xFE, 0x80, 0x10, 0x80, 0xF0, 0x80, 0x20, 0xE0, 0xE0,
    0x1C, 0x40, 0x03, 0xC0, 0x00, 0x00, 0x00, 0x00,
};

//显示图片
//x,y:起点坐标
//p_w:图片宽（单位像素）
//p_h:图片高（单位像素）
//*p:图片起始地址
void LCD_showPicture(uint8_t x,uint8_t y,uint8_t *p,uint8_t p_w,uint8_t p_h,uint16_t color)
{
    uint8_t temp,i,col,row;
    uint8_t y0=y;
    uint8_t width=p_w;
    if(x+p_w>LCD_W)width=LCD_W-p_w;//实际显示宽度
    uint8_t high=p_h;
    if(y+p_h>LCD_H)high=LCD_H-p_h;//实际显示高度
    uint8_t exp_col_bytes=(p_h/8+((p_h%8)?1:0));//显示一列的字节数
    uint8_t act_col_bytes=(high/8+((high%8)?1:0));//实际显示一列的字节数

    for(row=0; row<width; row++) //列++
    {
        for(col=0; col<act_col_bytes; col++) //显示一列
        {
            temp = p[col+row*exp_col_bytes];
            for(i=0; i<8; i++)
            {
                if(temp&0x80)LCD_DrawPoint(x,y,color);
                //else LCD_DrawPoint(x,y,color);
                temp<<=1;
                y++;
                if((y-y0)==high)
                {
                    y=y0;
                    x++;
                    break;
                }
            }
        }
    }
}

void LCD_Draw_Bitmap(int16_t x, int16_t y, uint8_t *bitmap, uint16_t p_w, uint16_t p_h,uint16_t color)
{
    int16_t x0 = x;
    uint16_t col_bytes = (p_w >> 3) + ((p_w % 8) ? 1 : 0); //一行字节数

    for (int col_i = 0; col_i < p_h; col_i++) //行++
    {
        for (int col = 0; col < col_bytes; col++) //显示一行
        {
            uint8_t temp = bitmap[col_i * col_bytes + col];

            for (int i = 0; i < 8; i++) // 显示一个字节
            {

                if ((x >= 0) && (y >= 0) && (x < LCD_W) && (y < LCD_H))
                {
                    if(temp&0x80)
                        LCD_DrawPoint(x,y,color);
                }
                temp <<= 1;
                x++;
                if ((x - x0) == p_w) /* 显示达到宽度或大于限制窗口，换行 */
                {
                    x = x0;
                    y++;                           /* 指向下一行（逐行式） */
                    break;
                }
            }

            if (x == x0) break; //换行
        }
    }
}
